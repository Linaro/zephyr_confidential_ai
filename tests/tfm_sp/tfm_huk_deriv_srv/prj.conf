## CMakeLists.txt
```
# SPDX-License-Identifier: Apache-2.0

cmake_minimum_required(VERSION 3.20.0)
find_package(Zephyr REQUIRED HINTS $ENV{ZEPHYR_BASE})

set(ZEPHY_SECURE_INFER_SRC_PATH ${CMAKE_CURRENT_LIST_DIR}/../../../)

get_target_property(TFM_BINARY_DIR tfm TFM_BINARY_DIR)
set(APP_SOURCE_DIR ${ZEPHY_SECURE_INFER_SRC_PATH})
configure_file(
  ${ZEPHY_SECURE_INFER_SRC_PATH}/tfm_secure_partitions/tfm_manifest_list.yaml.in
  ${CMAKE_CURRENT_BINARY_DIR}/tfm_secure_partitions/tfm_manifest_list.yaml
  @ONLY
)

set_property(TARGET zephyr_property_target
  APPEND PROPERTY TFM_CMAKE_OPTIONS
  -DTFM_EXTRA_MANIFEST_LIST_FILES=${CMAKE_CURRENT_BINARY_DIR}/tfm_secure_partitions/tfm_manifest_list.yaml
  -DTFM_EXTRA_PARTITION_PATHS="${ZEPHY_SECURE_INFER_SRC_PATH}/tfm_secure_partitions/tfm_huk_deriv_srv\\\;${ZEPHY_SECURE_INFER_SRC_PATH}/tfm_secure_partitions/tfm_test_helper_service")

if(${CONFIG_BUILD_HUK_KEY_DERIV_TEST})
    set_property(TARGET zephyr_property_target
        APPEND PROPERTY TFM_CMAKE_OPTIONS
        -DBUILD_HUK_KEY_DERIV_TEST=true
        )
endif()

project(tfm_huk_deriv_srv_test)

FILE(GLOB TESTSUITE_SOURCES src/*.c)
FILE(GLOB TEST_HELPER_SERVICE_API ../test_service/*.c)
target_sources(app
    PRIVATE
        ${TESTSUITE_SOURCES}
        ${TEST_HELPER_SERVICE_API}
        ${ZEPHY_SECURE_INFER_SRC_PATH}/src/tfm_partition_huk.c
        ${ZEPHY_SECURE_INFER_SRC_PATH}/src/key_mgmt.c
        ${ZEPHY_SECURE_INFER_SRC_PATH}/src/cose/cose_verify.c
        ${ZEPHY_SECURE_INFER_SRC_PATH}/src/cose/mbedtls_ecdsa_verify_sign.c
        ${ZEPHY_SECURE_INFER_SRC_PATH}ext/NanoCBOR/src/decoder.c
        ${ZEPHY_SECURE_INFER_SRC_PATH}ext/NanoCBOR/src/encoder.c
)

target_include_directories(app
    PRIVATE
        ${ZEPHYR_TRUSTED_FIRMWARE_M_MODULE_DIR}/interface/include
        ${CMAKE_CURRENT_LIST_DIR}/../test_service
        ${ZEPHY_SECURE_INFER_SRC_PATH}/include
        ${ZEPHY_SECURE_INFER_SRC_PATH}/ext/NanoCBOR/include
)

target_compile_definitions(app PRIVATE
  TFM_PARTITION_HUK_KEY_DERIVATION
  TFM_PARTITION_TEST_HELPER_SERVICE
  NANOCBOR_BYTEORDER_HEADER=<zephyr/sys/byteorder.h>
  NANOCBOR_BE64TOH_FUNC=sys_be64_to_cpu
  NANOCBOR_HTOBE64_FUNC=sys_cpu_to_be64
  NANOCBOR_HTOBE32_FUNC=sys_cpu_to_be32
)

add_compile_definitions(CONFIG_NONSECURE_COSE_VERIFY_SIGN)

# In TF-M, default value of CRYPTO_ENGINE_BUF_SIZE is 0x2080. It causes
# insufficient memory failure while verifying signature. Increase it to 0x2400.
set_property(TARGET zephyr_property_target
             APPEND PROPERTY TFM_CMAKE_OPTIONS
             -DCRYPTO_ENGINE_BUF_SIZE=0x2400
)

zephyr_include_directories(${ZEPHY_SECURE_INFER_SRC_PATH}/src/tls_config)
```

## Kconfig
```
# Copyright (c) 2022 Linaro
# SPDX-License-Identifier: Apache-2.0

config BUILD_HUK_KEY_DERIV_TEST
	bool "Enable HUK key deriv integration test build."
	default y
	help
	  Enable HUK key deriv integration test build.

source "Kconfig.zephyr"
```

## prj.conf
```kconfig
CONFIG_ZTEST=y
CONFIG_ZTEST_NEW_API=y
CONFIG_TEST_EXTRA_STACK_SIZE=1024

# TF-M
CONFIG_BUILD_WITH_TFM=y
CONFIG_TFM_IPC=y
# CONFIG_TFM_CMAKE_BUILD_TYPE_DEBUG=y

# The Zephyr CMSIS emulation assumes that ticks are ms, currently
CONFIG_SYS_CLOCK_TICKS_PER_SEC=1000

# Stack/Heap config
CONFIG_MAIN_STACK_SIZE=8192
CONFIG_HEAP_MEM_POOL_SIZE=4096

# Enable floating point print in Zephyr
CONFIG_NEWLIB_LIBC=y
CONFIG_NEWLIB_LIBC_FLOAT_PRINTF=y
CONFIG_CBPRINTF_FP_SUPPORT=y

# Mbed TLS
CONFIG_MBEDTLS=y
CONFIG_MBEDTLS_BUILTIN=y
CONFIG_MBEDTLS_ENABLE_HEAP=y
CONFIG_MBEDTLS_HEAP_SIZE=32768
CONFIG_MBEDTLS_SSL_MAX_CONTENT_LEN=10240
CONFIG_MBEDTLS_PEM_CERTIFICATE_FORMAT=y
CONFIG_MBEDTLS_USER_CONFIG_ENABLE=y
CONFIG_MBEDTLS_USER_CONFIG_FILE="user-tls.h"

# ECDSA modes
CONFIG_MBEDTLS_ECP_ALL_ENABLED=y
CONFIG_MBEDTLS_KEY_EXCHANGE_ECDHE_ECDSA_ENABLED=y
CONFIG_MBEDTLS_KEY_EXCHANGE_ECDH_ECDSA_ENABLED=y

# JSON
CONFIG_JSON_LIBRARY=y

# Enforce stack protection.
CONFIG_HW_STACK_PROTECTION=y
CONFIG_MPU_STACK_GUARD=y
```

## src/main.c
```c
/*
 * Copyright (c) 2022 Linaro Limited
 *
 * SPDX-License-Identifier: Apache-2.0
 */

#include <zephyr/ztest.h>
#include <zephyr/logging/log.h>

#include "tfm_test_helper_service_api.h"
#include "key_mgmt.h"
#include "cose/cose_verify.h"
#include "tfm_partition_huk.h"
#include "cose/mbedtls_ecdsa_verify_sign.h"
#include "psa_manifest/sid.h"

/** Declare a reference to the application logging interface. */
LOG_MODULE_DECLARE(app, CONFIG_LOG_DEFAULT_LEVEL);

/*
 * @brief  Verifies the COSE SIGN1 signature of the supplied payload.
 */
psa_status_t tfm_huk_cose_verify_signature(uint8_t *enc_buf,
					   size_t enc_buf_len,
					   uint8_t *pubkey,
					   size_t pubkey_len)
{
	uint8_t *dec;
	size_t len_dec;
	cose_sign_context_t ctx;
	int status;

	status = mbedtls_ecp_load_pubkey(&ctx.pk,
					 pubkey,
					 pubkey_len);

	if (status != 0) {
		LOG_ERR("Load the public key failed\n");
		goto err;
	}

	status = cose_sign_init(&ctx);
	if (status != COSE_ERROR_NONE) {
		LOG_ERR("Failed to initialize COSE signing context.\n");
		goto err;
	}

	status = cose_verify_sign1(&ctx,
				   enc_buf,
				   enc_buf_len,
				   (const uint8_t **) &dec,
				   &len_dec);
	if (status != COSE_ERROR_NONE) {
		LOG_ERR("Failed to authenticate signature. %d\n", status);
		goto err;
	}

	return status;
err:
	cose_sign_free(&ctx);
	return status;
}

/**
 * @brief Test CBOR encode
 *
 * This test verifies CBOR encode.
 *
 */
ZTEST(tfm_huk_deriv_srv, test_huk_cbor_enc){
	psa_status_t status;
	test_run_status_t test_status = TEST_FAILED;

	status = psa_test_helper(TEST_HUK_ENC_CBOR, &test_status, NULL, NULL);
	zassert_equal(PSA_SUCCESS, status, "PSA test helper API called failed");
	zassert_equal(TEST_SUCCEED, test_status, "test_huk_cbor_enc test failed");
}

/**
 * @brief Test COSE encode sign
 *
 * This test verifies COSE encode sign.
 *
 */
ZTEST(tfm_huk_deriv_srv, test_huk_cose_enc_sign){
	psa_status_t status;
	test_run_status_t test_status = TEST_FAILED;

	status = psa_test_helper(TEST_HUK_ENC_COSE_SIGN1, &test_status, NULL, NULL);
	zassert_equal(PSA_SUCCESS, status, "PSA test helper API called failed");
	zassert_equal(TEST_SUCCEED, test_status, "test_huk_cose_enc_sign test failed");
}

/**
 * @brief Test COSE encode wrong format
 *
 * This test verifies invalid COSE encode wrong format.
 *
 */
ZTEST(tfm_huk_deriv_srv, test_huk_cose_enc_wrong_format){
	psa_status_t status;
	test_run_status_t test_status = TEST_FAILED;

	status = psa_test_helper(TEST_HUK_ENC_WRONG_FORMAT, &test_status, NULL, NULL);
	zassert_equal(PSA_ERROR_INVALID_ARGUMENT, status, "PSA test helper API called failed");
	zassert_equal(TEST_SUCCEED, test_status, "test_huk_cose_enc_wrong_format test failed");
}

/**
 * @brief Test COSE encode buffer overflow
 *
 * This test verifies COSE encode buffer overflow negative test.
 *
 */
ZTEST(tfm_huk_deriv_srv, test_huk_cose_enc_buffer_overflow){
	psa_status_t status;
	test_run_status_t test_status = TEST_FAILED;

	status = psa_test_helper(TEST_HUK_ENC_BUFFER_OVERFLOW, &test_status, NULL, NULL);
	zassert_equal(PSA_ERROR_BUFFER_TOO_SMALL, status, "PSA test helper API called failed");
	zassert_equal(TEST_SUCCEED, test_status, "test_huk_cose_enc_buffer_overflow test failed");
}

/**
 * @brief Test COSE encode verify the signature using public key
 *
 * This test verifies the signature of the COSE encoded payload.
 *
 */
ZTEST(tfm_huk_deriv_srv, test_huk_cose_verify_sign){
	psa_status_t status;
	test_run_status_t test_status = TEST_FAILED;
	uint8_t encoded_buf[BUF_MAX_VALUE_SZ];
	size_t encoded_buf_len = 0;
	uint8_t public_key[KM_PUBLIC_KEY_SIZE] = { 0 };   /* EC public key = 65 bytes. */
	psa_key_id_t key_id = KEY_ID_COSE;

	status = psa_test_helper(TEST_HUK_COSE_VERIFY_SIGN, &test_status, encoded_buf, &encoded_buf_len);
	zassert_equal(PSA_SUCCESS, status, "PSA test helper API called failed");

	status = psa_huk_get_pubkey(&key_id,
				    public_key,
				    KM_PUBLIC_KEY_SIZE);
	zassert_equal(PSA_SUCCESS, status, "psa_export_public_key failed");

	status = tfm_huk_cose_verify_signature(encoded_buf,
					       encoded_buf_len,
					       public_key,
					       KM_PUBLIC_KEY_SIZE);
	zassert_equal(COSE_ERROR_NONE, status, "test_huk_cose_verify_sign test failed");
}

ZTEST_SUITE(tfm_huk_deriv_srv, NULL, NULL, NULL, NULL, NULL);
```
